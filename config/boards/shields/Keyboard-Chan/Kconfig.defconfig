## config/boards/shields/Keyboard-Chan/Kconfig.defconfig
```kconfig
if SHIELD_KEYBOARDCHAN

config ZMK_KEYBOARD_NAME
    default "KeyboardChan"

endif
```

## config/boards/shields/KeyboardChan/Kconfig.defconfig
```kconfig
if SHIELD_KEYBOARDCHAN

config ZMK_KEYBOARD_NAME
    default "Keyboard Chan"

endif
```
